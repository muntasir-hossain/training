## Bootlin/Yocto-Project-and-OpenEmbedded-system-development/meta-bootlinlabs/conf/machine/bootlinlabs.conf
```bitbake
require conf/machine/include/ti-soc.inc

DEFAULTTUNE = "armv7athf-neon"
require conf/machine/include/tune-cortexa8.inc

# Increase this everytime you change something in the kernel
MACHINE_KERNEL_PR = "r0"

# Default providers, may need to override for specific machines
PREFERRED_PROVIDER_virtual/kernel ?= "linux-ti-staging"
PREFERRED_PROVIDER_virtual/bootloader = "u-boot-ti-staging"
PREFERRED_PROVIDER_u-boot = "u-boot-ti-staging"

KERNEL_IMAGETYPE = "zImage"

KERNEL_DEVICETREE = "am335x-boneblack.dtb"

UBOOT_ARCH = "arm"
UBOOT_MACHINE = "am335x_evm_config"

UBOOT_ENTRYPOINT = "0x80008000"
UBOOT_LOADADDRESS = "0x80008000"

SPL_BINARY = "MLO"
UBOOT_SUFFIX = "img"

# Use the expected value of the ubifs filesystem's volume name in the kernel
# and u-boot.
UBI_VOLNAME = "rootfs"

MACHINE_FEATURES = "apm usbgadget usbhost vfat ext2 alsa ethernet"

IMAGE_FSTYPES += "tar.xz wic.xz"
WKS_FILE ?= "sdimage-2part.wks"
IMAGE_BOOT_FILES ?= "${SPL_BINARY} u-boot.${UBOOT_SUFFIX}"
do_image_wic[depends] += "virtual/bootloader:do_deploy"

SERIAL_CONSOLES = "115200;ttyS0"

IMAGE_INSTALL_append = " kernel-devicetree kernel-image-zimage"
```
